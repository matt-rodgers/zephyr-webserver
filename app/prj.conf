## CMakeLists.txt
```
# SPDX-License-Identifier: Apache-2.0

cmake_minimum_required(VERSION 3.20)
find_package(Zephyr REQUIRED HINTS $ENV{ZEPHYR_BASE})

project(app LANGUAGES C)

target_sources(app PRIVATE
    src/main.c
    src/static_resources.c
)

# Include custom iterable section for HTTP resources
zephyr_linker_sources(SECTIONS http_iterables.ld)

zephyr_linker_section(NAME
    http_resource_desc_http_service
    KVMA RAM_REGION GROUP RODATA_REGION
    SUBALIGN ${CONFIG_LINKER_ITERABLE_SUBALIGN}
)

# Collect all files used by the frontend build process
# (may need to be updated if any image assets are added)
file(GLOB_RECURSE FRONTEND_SOURCES
    ${CMAKE_CURRENT_SOURCE_DIR}/frontend/*.js
    ${CMAKE_CURRENT_SOURCE_DIR}/frontend/*.jsx
    ${CMAKE_CURRENT_SOURCE_DIR}/frontend/*.html
    ${CMAKE_CURRENT_SOURCE_DIR}/frontend/*.css
)

# Exclusions from glob pattern above
list(FILTER FRONTEND_SOURCES EXCLUDE REGEX ${CMAKE_CURRENT_SOURCE_DIR}/frontend/node_modules/.*)
list(FILTER FRONTEND_SOURCES EXCLUDE REGEX ${CMAKE_CURRENT_SOURCE_DIR}/frontend/dist/.*)

set(FRONTEND_BUILD_OUTPUTS
    ${CMAKE_CURRENT_SOURCE_DIR}/frontend/dist/index.html
    ${CMAKE_CURRENT_SOURCE_DIR}/frontend/dist/assets/index.js
    ${CMAKE_CURRENT_SOURCE_DIR}/frontend/dist/assets/index.css
)

# Custom command for the frontend build
add_custom_command(
    OUTPUT ${FRONTEND_BUILD_OUTPUTS}
    COMMAND npm run build
    WORKING_DIRECTORY ${CMAKE_CURRENT_SOURCE_DIR}/frontend
    DEPENDS ${FRONTEND_SOURCES}
    COMMENT "Running frontend build"
    VERBATIM
)

# Custom target for the frontend build
add_custom_target(frontend_build
    DEPENDS ${FRONTEND_BUILD_OUTPUTS}
)

# App build depends on the frontend build
add_dependencies(app frontend_build)

# Generate gzipped static resources
set(gen_dir ${ZEPHYR_BINARY_DIR}/include/generated/)

foreach(web_resource
    index.html
    assets/index.js
    assets/index.css
)
    generate_inc_file_for_target(
        app
        frontend/dist/${web_resource}
        ${gen_dir}/${web_resource}.gz.inc
        --gzip
    )
endforeach()
```

## prj.conf
```kconfig
# SPDX-License-Identifier: Apache-2.0

# General
CONFIG_LOG=y
CONFIG_SHELL=y
CONFIG_FDTABLE=y
CONFIG_EVENTFD=y
CONFIG_POSIX_API=y # Filesystem stuff doesn't seem to build without POSIX API

# Networking
CONFIG_NETWORKING=y
CONFIG_NET_LOG=y
CONFIG_NET_SHELL=y
CONFIG_NET_IPV4=y
CONFIG_NET_IPV6=y
CONFIG_NET_SOCKETS=y
CONFIG_NET_TCP=y

# Increase network buffers, contexts etc
CONFIG_ZVFS_POLL_MAX=16
CONFIG_NET_MAX_CONN=16
CONFIG_NET_MAX_CONTEXTS=16
CONFIG_NET_PKT_RX_COUNT=16
CONFIG_NET_PKT_TX_COUNT=16
CONFIG_NET_BUF_RX_COUNT=128
CONFIG_NET_BUF_TX_COUNT=128

# HTTP Server
CONFIG_HTTP_SERVER=y

# Net config (for testing)
CONFIG_NET_CONFIG_SETTINGS=y
CONFIG_NET_CONFIG_NEED_IPV4=y
CONFIG_NET_CONFIG_NEED_IPV6=y
CONFIG_NET_CONFIG_MY_IPV4_ADDR="192.0.2.1"
CONFIG_NET_CONFIG_PEER_IPV4_ADDR="192.0.2.2"
CONFIG_NET_CONFIG_MY_IPV4_GW="192.0.2.2"
CONFIG_NET_CONFIG_MY_IPV6_ADDR="2001:db8::1"
CONFIG_NET_CONFIG_PEER_IPV6_ADDR="2001:db8::2"
```

## src/main.c
```c
/*
 * SPDX-License-Identifier: Apache-2.0
 */

#include <zephyr/kernel.h>
#include <zephyr/logging/log.h>
#include <zephyr/net/http/server.h>
#include <zephyr/net/http/service.h>

#include <app_version.h>

LOG_MODULE_REGISTER(main, CONFIG_APP_LOG_LEVEL);

static uint16_t http_port = 80;
HTTP_SERVICE_DEFINE(http_service, NULL, &http_port, CONFIG_HTTP_SERVER_MAX_CLIENTS, 10, NULL);

int main(void)
{
    LOG_INF("Starting app: version " APP_VERSION_EXTENDED_STRING
            ", build version " STRINGIFY(APP_BUILD_VERSION));

    if (0 != http_server_start()) {
        LOG_ERR("Failed to start HTTP server");
        return -EINVAL;
    }

    return 0;
}
```

## src/static_resources.c
```c
/*
 * SPDX-License-Identifier: Apache-2.0
 */

#include <zephyr/net/http/server.h>
#include <zephyr/net/http/service.h>

/*
 * index.html
 */
static uint8_t index_html_gz[] = {
#include "index.html.gz.inc"
};

static struct http_resource_detail_static index_html_res_detail = {
    .common =
        {
            .type = HTTP_RESOURCE_TYPE_STATIC,
            .bitmask_of_supported_http_methods = BIT(HTTP_GET),
            .content_encoding = "gzip",
            .content_type = "text/html",
        },
    .static_data = index_html_gz,
    .static_data_len = sizeof(index_html_gz),
};

HTTP_RESOURCE_DEFINE(index_html_res, http_service, "/", &index_html_res_detail);

/*
 * index.js
 */
static uint8_t index_js_gz[] = {
#include "assets/index.js.gz.inc"
};

static struct http_resource_detail_static index_js_res_detail = {
    .common =
        {
            .type = HTTP_RESOURCE_TYPE_STATIC,
            .bitmask_of_supported_http_methods = BIT(HTTP_GET),
            .content_encoding = "gzip",
            .content_type = "text/javascript",
        },
    .static_data = index_js_gz,
    .static_data_len = sizeof(index_js_gz),
};

HTTP_RESOURCE_DEFINE(index_js_res, http_service, "/assets/index.js", &index_js_res_detail);

/*
 * index.css
 */
static uint8_t index_css_gz[] = {
#include "assets/index.css.gz.inc"
};

static struct http_resource_detail_static index_css_res_detail = {
    .common =
        {
            .type = HTTP_RESOURCE_TYPE_STATIC,
            .bitmask_of_supported_http_methods = BIT(HTTP_GET),
            .content_encoding = "gzip",
            .content_type = "text/css",
        },
    .static_data = index_css_gz,
    .static_data_len = sizeof(index_css_gz),
};

HTTP_RESOURCE_DEFINE(index_css_res, http_service, "/assets/index.css", &index_css_res_detail);
```
