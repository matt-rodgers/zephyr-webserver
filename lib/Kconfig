## lib/Kconfig
```kconfig
# SPDX-License-Identifier: Apache-2.0

menu "Zephyr Webserver Libraries"

endmenu
```

## west.yml
```yaml
# SPDX-License-Identifier: Apache-2.0

manifest:
  self:
    path: zephyr-webserver

  remotes:
    - name: zephyrproject-rtos
      url-base: https://github.com/zephyrproject-rtos

  projects:
    - name: zephyr
      remote: zephyrproject-rtos
      revision: main
      import:
        name-allowlist:
          - cmsis
          - hal_stm32
```
